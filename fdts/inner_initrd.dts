/*
 * Copyright (c) 2019-2020, Arm Limited. All rights reserved.
 *
 * SPDX-License-Identifier: BSD-3-Clause
 */

/dts-v1/;

/ {

	hypervisor {
		compatible = "hafnium,hafnium";
		spci_tee;

		vm1 {
			debug_name = "linux_test";
			kernel_filename = "vmlinuz";
			ramdisk_filename = "initrd.img";
			uuid = < 0x00 0x00 0x00 0x01 >;
			messaging_method = < 0x02 >;
		};
	};
};
