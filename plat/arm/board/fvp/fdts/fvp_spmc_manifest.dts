/dts-v1/;

/ {
	compatible = "arm,spmc_rd";

	attribute {
		spmc_id = <0x8000>;
		maj_ver = <0x0>;
		min_ver = <0x9>;
		runtime_el = <0x1>;
		exec_state = <0x0>;
		load_address = <0x0 0x6000000>;
		entrypoint = <0x0 0x6000000>;
	};
};
